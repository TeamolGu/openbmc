## meta-luxshare/meta-palos/conf/layer.conf
```bitbake
# We have a conf and classes directory, add to BBPATH
BBPATH .= ":${LAYERDIR}"

# We have recipes-* directories, add to BBFILES
BBFILES += "${LAYERDIR}/recipes-*/*/*.bb \
            ${LAYERDIR}/recipes-*/*/*.bbappend \
            ${LAYERDIR}/recipes-*/*/*/*.bbappend"

BBFILE_COLLECTIONS += "palos-layer"
BBFILE_PATTERN_palos-layer := "^${LAYERDIR}/"
LAYERSERIES_COMPAT_palos-layer = "honister kirkstone"
```
